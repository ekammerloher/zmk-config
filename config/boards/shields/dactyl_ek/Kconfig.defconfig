## config/boards/shields/dactyl_ek/Kconfig.defconfig
```kconfig
if SHIELD_DACTYL_EK_LEFT

config ZMK_KEYBOARD_NAME
    default "Dactyl EK"

config ZMK_SPLIT_ROLE_CENTRAL
    default y
endif

if SHIELD_DACTYL_EK_LEFT || SHIELD_DACTYL_EK_RIGHT

config ZMK_SPLIT
    default y

endif
```

## config/boards/shields/dactyl_ek/Kconfig.shield
```kconfig
config SHIELD_DACTYL_EK_LEFT
    def_bool $(shields_list_contains,dactyl_ek_left)
config SHIELD_DACTYL_EK_RIGHT
    def_bool $(shields_list_contains,dactyl_ek_right)
```

## config/boards/shields/dactyl_ek1/Kconfig.shield
```kconfig
config SHIELD_DACTYL_EK1
    def_bool $(shields_list_contains,shield_dactyl_ek1)
```

## config/boards/shields/dactyl_ek2/Kconfig.shield
```kconfig
config SHIELD_DACTYL_EK2
    def_bool $(shields_list_contains,shield_dactyl_ek2)
```

#include "dactyl_ek.dtsi"

&default_transform {
    col-offset = <6>;
};

&kscan0 {
    col-gpios
        = <&gpio0 6  GPIO_ACTIVE_HIGH> // col5 in the schematic
        , <&gpio0 4  GPIO_ACTIVE_HIGH> // col4 in the schematic
        , <&gpio1 11 GPIO_ACTIVE_HIGH> // col3 in the schematic
        , <&gpio0 0  GPIO_ACTIVE_HIGH> // col2 in the schematic
        , <&gpio1 24 GPIO_ACTIVE_HIGH> // col1 in the schematic
        , <&gpio1 22 GPIO_ACTIVE_HIGH> // col0 in the schematic
        ;
};
